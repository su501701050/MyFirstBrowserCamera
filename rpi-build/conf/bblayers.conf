## rpi-build/conf/bblayers.conf
```bitbake
# POKY_BBLAYERS_CONF_VERSION is increased each time build/conf/bblayers.conf
# changes incompatibly
POKY_BBLAYERS_CONF_VERSION = "2"

BBPATH = "${TOPDIR}"
BBFILES ?= ""

BBLAYERS ?= " \
  /home/raspberry/yocto/poky/meta \
  /home/raspberry/yocto/poky/meta-poky \
  /home/raspberry/yocto/poky/meta-yocto-bsp \
  /home/raspberry/yocto/poky/meta-raspberrypi \
  /home/raspberry/yocto/poky/meta-openembedded/meta-oe \
  /home/raspberry/yocto/poky/meta-openembedded/meta-python \
  /home/raspberry/yocto/poky/meta-openembedded/meta-multimedia \
  /home/raspberry/yocto/poky/meta-openembedded/meta-networking \
  /home/raspberry/yocto/poky/meta-raspberrypi-append \
  /home/raspberry/yocto/poky/rpi-build/workspace \
  "
```
